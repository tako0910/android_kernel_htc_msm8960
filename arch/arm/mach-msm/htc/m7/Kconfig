## arch/arm/mach-msm/htc/m7/Kconfig
```kconfig
config BOARD_HEADER_FILE
	string "HTC board specific header file name"
	default ""

config MACH_M7_UL
	depends on ARCH_APQ8064
	select MACH_HTC
	bool "HTC One"
	help
	  Support for the HTC M7 device.

config MACH_M7_WLJ
        depends on ARCH_APQ8064
        bool "HTC J One"
        select FB_MSM_MIPI_DSI
        help
          Support for the HTC APQ8064 M7_WLJ.

config CABC_DIMMING_SWITCH
	depends on MACH_M7_UL
	bool "Enable panel CABC dimming switch"
	default y
	help
	  Enable CABC dimming switch.

config SRE_CONTROL
	depends on MACH_M7_UL
	bool "Enable panel SRE control"
	default y
	help
	  Enable SRE control.
```
